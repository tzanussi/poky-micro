## scripts/lib/image/canned-wks/micro-galileo.wks
```
# short-description: Create the microLinux micro-galileo disk image
# long-description: Creates the partitioned disk image that the user
# can directly dd to the sdcard.

part /boot --source micro-galileo --size 50 --ondisk mmcblk0 --fstype=msdos --label msdos --active --align 1024

part / --source rootfs --size 500 --ondisk mmcblk0 --fstype=ext3 --label platform --align 1024
```

## scripts/lib/image/canned-wks/micro-minnowmax-64-sdcard.wks
```
# short-description: Create the microLinux micro-minnowmax-64 disk image
# long-description: Creates the partitioned disk image that the user
# can directly dd to an SD card.

part /boot --source micro-minnowmax-64 --sourceparams="loader=grub-efi" --ondisk mmcblk --label msdos --active --align 1024

part / --source rootfs --ondisk mmcblk --fstype=ext3 --label platform --align 1024

part swap --ondisk mmcblk --size 44 --label swap1 --fstype=swap

bootloader  --timeout=10  --append="rootwait rootfstype=ext3 console=ttyS0,115200 console=tty1 vmalloc=256MB snd-hda-intel.enable_msi=0"
```

## scripts/lib/image/canned-wks/micro-minnowmax-64-usbdisk.wks
```
# short-description: Create the microLinux micro-minnowmax-64 disk image
# long-description: Creates the partitioned disk image that the user
# can directly dd to a USB stick.

part /boot --source micro-minnowmax-64 --sourceparams="loader=grub-efi" --ondisk sda --label msdos --active --align 1024

part / --source rootfs --ondisk sda --fstype=ext3 --label platform --align 1024

part swap --ondisk sda --size 44 --label swap1 --fstype=swap

bootloader  --timeout=10  --append="rootwait rootfstype=ext3 console=ttyS0,115200 console=tty1 vmalloc=256MB snd-hda-intel.enable_msi=0"
```
